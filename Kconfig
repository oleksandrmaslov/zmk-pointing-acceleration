## Kconfig
```kconfig
# SPDX-License-Identifier: MIT
# Kconfig для ZMK Input Processor Acceleration

config ZMK_INPUT_PROCESSOR_ACCELERATION
    bool "Enable input processor acceleration"
    default n
    depends on ZMK_POINTING
    depends on INPUT
    help
        Enables velocity-based acceleration for relative pointer input events.

config INPUT_PROCESSOR_ACCELERATION_INIT_PRIORITY
    int "Input processor acceleration initialization priority"
    default 90
    depends on ZMK_INPUT_PROCESSOR_ACCELERATION

config INPUT_PROCESSOR_ACCEL_PAIR_WINDOW_MS
    int "Input processor acceleration pair window (ms)"
    default 10
    depends on ZMK_INPUT_PROCESSOR_ACCELERATION
    help
      Time window in milliseconds to pair X/Y events for acceleration.

config INPUT_PROCESSOR_ACCEL_Y_ASPECT_SCALE
    int "Y axis aspect ratio scale (scaled by 1000, e.g. 1200 = 1.2x)"
    default 1500
    depends on ZMK_INPUT_PROCESSOR_ACCELERATION
    help
      Scale factor for Y axis movement to adjust for screen aspect ratio.
      1000 = 1.0x, 1200 = 1.2x, etc.

config INPUT_PROCESSOR_ACCEL_MIN_FACTOR
    int "Minimum acceleration factor (scaled by 1000)"
    default 1000
    depends on ZMK_INPUT_PROCESSOR_ACCELERATION
    help
      Minimum acceleration factor. 1000 = 1.0x (no acceleration).

config INPUT_PROCESSOR_ACCEL_MAX_FACTOR
    int "Maximum acceleration factor (scaled by 1000)"
    default 2500
    depends on ZMK_INPUT_PROCESSOR_ACCELERATION
    help
      Maximum acceleration factor. 2500 = 2.5x acceleration.

config INPUT_PROCESSOR_ACCEL_SPEED_THRESHOLD
    int "Speed threshold for acceleration start"
    default 500
    depends on ZMK_INPUT_PROCESSOR_ACCELERATION
    help
      Speed threshold below which no acceleration is applied.

config INPUT_PROCESSOR_ACCEL_SPEED_MAX
    int "Maximum speed for acceleration calculation"
    default 4000
    depends on ZMK_INPUT_PROCESSOR_ACCELERATION
    help
      Speed at which maximum acceleration factor is reached.

config INPUT_PROCESSOR_ACCEL_EXPONENT
    int "Acceleration curve exponent"
    default 2
    range 1 3
    depends on ZMK_INPUT_PROCESSOR_ACCELERATION
    help
      Exponent for acceleration curve. 1=linear, 2=quadratic, 3=cubic.

config INPUT_PROCESSOR_ACCEL_SENSOR_DPI
    int "Mouse sensor DPI/CPI setting"
    default 1600
    depends on ZMK_INPUT_PROCESSOR_ACCELERATION
    help
      DPI/CPI setting of the mouse sensor. Used for automatic scaling adjustment.
      Higher DPI sensors will have reduced acceleration to prevent oversensitivity.
```

## dts/bindings/zmk,input-processor-acceleration.yaml
```yaml
# SPDX-License-Identifier: MIT
description: ZMK Velocity-Based Pointer Acceleration Input Processor

compatible: "zmk,input-processor-acceleration"

properties:
  input-type:
    type: int
    required: true
    description: Input event type to accelerate (e.g. INPUT_EV_REL for relative events)

  codes:
    type: array
    required: true
    description: Array of event code values to accelerate (e.g. REL_X, REL_Y)

  min-factor:
    type: int
    default: 1000 # 1.000x (no deceleration by default)
    description: Minimum pointer speed factor (scaled by 1000). Values <1000 slow down movements at very low speeds (e.g. 500 for 0.5x).

  max-factor:
    type: int
    default: 3500 # 3.500x
    description: Maximum pointer speed factor (scaled by 1000). Movement will be accelerated up to this factor at high speeds.

  speed-threshold:
    type: int
    default: 1000 # counts per second
    description: Pointer speed (counts per second) at which acceleration factor reaches 1.0 (no scaling). Below this speed, movements may be decelerated; above it, movements accelerate.

  speed-max:
    type: int
    default: 6000 # counts per second
    description: Pointer speed (counts per second) at which the acceleration factor reaches max-factor. Movements faster than this use the maximum acceleration.

  acceleration-exponent:
    type: int
    default: 1 # 1 = linear
    description: Exponent for the acceleration curve. 1 = linear acceleration. 2 or higher applies a more exponential (polynomial) curve for acceleration above the threshold.

  track-remainders:
    type: boolean
    description: Accumulate and apply fractional movement remainders for higher precision.

  pair-window-ms:
    type: int
    default: 10
    description: Time window in milliseconds to pair X/Y events for acceleration.

  x-aspect-scale:
    type: int
    description: X axis aspect ratio scaling factor

  y-aspect-scale:
    type: int
    default: 1500
    description: Scale factor for Y axis movement to adjust for screen aspect ratio (scaled by 1000, e.g. 1500 = 1.5x).

  sensor-dpi:
    type: int
    default: 1600
    description: Mouse sensor DPI/CPI setting. Used for automatic scaling adjustment. Higher DPI sensors will have reduced acceleration to prevent oversensitivity.

  target-dpi:
    type: int
    description: Target DPI for pointer movement scaling. Used to adjust acceleration for a desired on-screen sensitivity.

  dpi-multiplier:
    type: int
    description: Multiplier for DPI scaling, used to fine-tune pointer sensitivity (scaled by 1000, e.g. 1500 = 1.5x).
```

## src/Kconfig
```kconfig
# SPDX-License-Identifier: MIT
# Kconfig для ZMK Input Processor Acceleration

DT_COMPAT_ZMK_INPUT_PROCESSOR_ACCELERATION := zmk,input-processor-acceleration

config ZMK_INPUT_PROCESSOR_ACCELERATION
    bool "Enable input processor acceleration"
    default $(dt_compat_enabled,$(DT_COMPAT_ZMK_INPUT_PROCESSOR_ACCELERATION))
    depends on ZMK_POINTING
    depends on INPUT
    default y
    depends on (!ZMK_SPLIT || ZMK_SPLIT_ROLE_CENTRAL)
    help
        Enables velocity-based acceleration for relative pointer input events.

config ZMK_INPUT_PROCESSOR_INIT_PRIORITY
    int "Input processor acceleration initialization priority"
    default INPUT_INIT_PRIORITY
    depends on ZMK_INPUT_PROCESSOR_ACCELERATION
```
